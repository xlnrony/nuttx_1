## apps/examples/ilock/Kconfig
```kconfig
#
# For a description of the syntax of this configuration file,
# see misc/tools/kconfig-language.txt.
#

config EXAMPLES_ILOCK
	bool "iLock application example"
	default n
	---help---
		Enable the iLock application example

if EXAMPLES_ILOCK

config EXAMPLES_ILOCK_DEFPRIO
	int "Waiter Thread Priority"
	default 100
	---help---
		Priority of "waiter" thread.  Default: 50

config EXAMPLES_ILOCK_STACKSIZE
	int "Waiter Thread Stack Size"
	default 2048
	---help---
		Stacksize of "waiter" thread. Default 1024
		
config DEBUG_ILOCK
	bool "iLock Debug Output"
	default y
	---help---
		Enable iLock debug SYSLOG output (disabled by default)		
		
config SETTING_FILE_PATH
	string "iLock setting file path"
	default "/mnt/sd/config.ini"
	---help---
		Setting file path to be used. Default: "/mnt/sd/config.ini"

config MACADDR_DEF_VALUE
	string "iLock default macaddr"
	default "FC:FC:FC:AB:AB:AB"
	---help---
		iLock default macaddr to be used. Default: "FC:FC:FC:AB:AB:AB"

config HOSTADDR_DEF_VALUE
	string "iLock default hostaddr"
	default "10.0.0.2"
	---help---
		iLock default hostaddr to be used. Default: "10.0.0.2"

config NETMASK_DEF_VALUE
	string "iLock default netmask"
	default "255.255.255.0"
	---help---
		iLock default netmask to be used. Default: "255.255.255.0"

config DRIPADDR_DEF_VALUE
	string "iLock default dripaddr"
	default "10.0.0.1"
	---help---
		iLock default dripaddr to be used. Default: "10.0.0.1"

config SVRADDR_DEF_VALUE
	string "iLock default server addr"
	default "10.0.0.128"
	---help---
		iLock default svraddr to be used. Default: "10.0.0.128"

config SVRPORT_DEF_VALUE
	int "iLock default server port"
	default 6699
	---help---
		iLock default server port to be used. Default 6699
		
config SHOCK_RESISTOR_DEF_VALUE
	int "Shock resistor default value"
	default 0
	---help---
		Shock resistor default value. Default 0
		
config INFRA_RED_DEF_VALUE
	int "Infra-red default value"
	default 400
	---help---
		Infra-red default value. Default 400

config PHOTO_RESISTOR_DEF_VALUE
	int "Photo resistor default value"
	default 512
	---help---
		Photo resistor default value. Default 512

config PUBKEY_DEF_VALUE
	string "Pubkey default value"
	default "FFFFFFFFFFFFFFFFFFFFFFFFFFFFFFFFFFFFFFFFFFFFFFFFFFFFFFFFFFFFFFFFFFFFFFFFFFFFFFFFFFFFFFFFFFFFFFFFFFFFFFFFFFFFFFFFFFFFFFFFFFFFFFFFFFFFFFFFFFFFFFFFFFFFFFFFFFFFFFFFFFFFFFFFFFFFFFFFFFFFFFFFFFFFFFFFFFFFFFFFFFFFFFFFFFFFFFFFFFFFFFFFFFFFFFFFFFFFFFFFFFFFFFFFFFFFFFFF"
	---help---
		Pubkey default to be used. Default: "FFFFFFFFFFFFFFFFFFFFFFFFFFFFFFFFFFFFFFFFFFFFFFFFFFFFFFFFFFFFFFFFFFFFFFFFFFFFFFFFFFFFFFFFFFFFFFFFFFFFFFFFFFFFFFFFFFFFFFFFFFFFFFFFFFFFFFFFFFFFFFFFFFFFFFFFFFFFFFFFFFFFFFFFFFFFFFFFFFFFFFFFFFFFFFFFFFFFFFFFFFFFFFFFFFFFFFFFFFFFFFFFFFFFFFFFFFFFFFFFFFFFFFFFFFFFFFFF"

config PUBKEY_SIZE
	int "Pubkey size value"
	default 128
	---help---
		Pubkey size value. Default 128

config GROUP_DEF_VALUE
	int "Group default value"
	default 0
	---help---
		Group default value. Default 0

config GROUP_SIZE
	int "Group size value"
	default 32
	---help---
		Group size value. Default 32
		
endif
```

## apps/system/syslog_enable/Kconfig
```kconfig
#
# For a description of the syntax of this configuration file,
# see misc/tools/kconfig-language.txt.
#

config SYSTEM_SYSLOG_ENABLE
	bool "NSH syslog_enable command"
	default n
	depends on SYSLOG_ENABLE
	---help---
		Enable support for the NSH syslog_enable command.

if SYSTEM_SYSLOG_ENABLE

config SYSTEM_SYSLOG_ENABLE_STACKSIZE
	int "NSH syslog_enable stack size"
	default 1024

endif
```

## nuttx/configs/ilstm407/Kconfig
```kconfig
#
# For a description of the syntax of this configuration file,
# see misc/tools/kconfig-language.txt.
#

if ARCH_BOARD_ILOCK_STM32F407

config EPASS3003_DEVNAME
	string "Epass3003 Device Name"
	default "/dev/epass3003a"
	---help---
		Name of epass3003 device to be used. Default: "/dev/epass3003a"
		
config SDCARD_MAPPED_PATH
	string "Mapped path of sdcard "
	default "/mnt/sd"
	---help---
		Mapped path of sdcard to be used. Default: "/mnt/sd"
		
config ADC1_DEVNAME
	string "SHOCK RESISTOR SENSOR ADC Device Name"
	default "/dev/adc1"
	---help---
		Name of adc device to be used. Default: "/dev/adc0"		

config ADC2_DEVNAME
	string "PHOTO RESISTOR SENSOR ADC Device Name"
	default "/dev/adc2"
	---help---
		Name of adc device to be used. Default: "/dev/adc1"		

config ADC3_DEVNAME
	string "INFRA-RED SENSOR ADC Device Name"
	default "/dev/adc3"
	---help---
		Name of adc device to be used. Default: "/dev/adc2"		
		
config LED1_DEVNAME
	string "LED1 Device Name"
	default "/dev/led1"
	---help---
		Name of led device to be used. Default: "/dev/led1"		

config LED2_DEVNAME
	string "LED2 Device Name"
	default "/dev/led2"
	---help---
		Name of led device to be used. Default: "/dev/led2"		

config LED3_DEVNAME
	string "LED3 Device Name"
	default "/dev/led3"
	---help---
		Name of led device to be used. Default: "/dev/led3"		

config IP_CONFLICT_DEVNAME
	string "IP conflict check Device Name"
	default "/dev/ipconflict"
	---help---
		Name of IP conflict check device to be used. Default: "/dev/ipconflict"		

config MAGNET_VCC_DEVNAME
	string "MAGNET VCC PIN Device Name"
	default "/dev/magnetvcc"
	---help---
		Name of gpio device to be used. Default: "/dev/magnetvcc"		

config BUZZER_DEVNAME
	string "BUZZER PIN Device Name"
	default "/dev/buzzer"
	---help---
		Name of gpio device to be used. Default: "/dev/buzzer"		

config CLOSE_SW_DEVNAME
	string "CLOSE_SW PIN Device Name"
	default "/dev/closesw"
	---help---
		Name of gpio device to be used. Default: "/dev/closesw"		

config KEYPAD_DEVNAME
	string "Keypad Device Name"
	default "/dev/keypad"
	---help---
		Name of keypad device to be used. Default: "/dev/keypad"		
		
config SAFE_MODE_FLAG_PATH
	string "Path of safe mode flag"
	default "/mnt/sd/safemode"
	---help---
		Path of safe mode flag to be used. Default: "/mnt/sd/safemode"		

config UPDATE_FM_FLAG_PATH
	string "Path of update firmware flag"
	default "/mnt/sd/updatefm"
	---help---
		Path of update firmware flag to be used. Default: "/mnt/sd/updatefm"		
				
endif
```

## nuttx/drivers/gpio/Kconfig
```kconfig
#
# For a description of the syntax of this configuration file,
# see misc/tools/kconfig-language.txt.
#

config GPIO
	bool "Gerneral purpose input output"
	default n
	---help---
		Select to enable support for GPIO device support.
		
menuconfig KEYPAD
	bool "Keypad Device Support"
	default n
	---help---
		Drivers for keypad devices.

if KEYPAD

config KEYPAD_BUFSIZE
	int "Keypad Buffer Size"
	default 16
	---help---
		Buffer Size of keypad device to be used. Default: 16
		
config KEYPAD_NPOLLWAITERS
	int "Max Number of Waiters for Poll Event"
	default 2
	depends on !DISABLE_POLL
	---help---
		If the poll() method is enabled, this defines the maximum number
		of threads that can be waiting for keypad events.  Default: 2.

endif # KEYPAD

config LED
	bool "Led Device Support"
	default n
	---help---
		Drivers for led devices.
```
